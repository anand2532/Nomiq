## firmware/components/board/Kconfig
```kconfig
menu "Nomiq board"

choice NOMIQ_BOARD
    prompt "Target hardware"
    default NOMIQ_BOARD_DEVKIT
    help
        DEVKIT: ESP32-S3-DevKitC-1 N16R8 + SX1262 module wired per
        hardware/bringup/devkit-wiring.md (Phases 1-6, no IO expander).
        PCB_A0: Nomiq custom board rev A0 (TCA9535 expander present).

config NOMIQ_BOARD_DEVKIT
    bool "Dev kit (ESP32-S3-DevKitC + SX1262 module)"
config NOMIQ_BOARD_PCB_A0
    bool "Nomiq PCB rev A0"
endchoice

config NOMIQ_DEVKIT_LORA_NRST_GPIO
    int "Dev kit: GPIO wired to SX1262 NRESET"
    depends on NOMIQ_BOARD_DEVKIT
    default 14

config NOMIQ_DEVKIT_TCXO
    bool "Dev kit: SX1262 module uses a DIO3-powered TCXO"
    depends on NOMIQ_BOARD_DEVKIT
    default y
    help
        Most E22-900M22S / Core1262 modules use a TCXO on DIO3; disable for crystal modules.

endmenu
```

## firmware/main/Kconfig.projbuild
```kconfig
menu "Nomiq application"

choice NOMIQ_APP_MODE
    prompt "App mode"
    default NOMIQ_APP_LINK_TEST
    help
        LINK_TEST: phase-1 radio link test on bare dev kits (serial log only).
        MESSENGER: full device (display, buttons, microSD, audio, camera, STT).
config NOMIQ_APP_LINK_TEST
    bool "Phase-1 link test"
config NOMIQ_APP_MESSENGER
    bool "Full messenger"
endchoice

config NOMIQ_PEER_ID
    hex "Peer device ID for link tests (0 = receive only)"
    default 0x0
    help
        32-bit ID printed by the other unit at boot ("device id xxxxxxxx").

config NOMIQ_PING_INTERVAL_MS
    int "Link-test ping interval (ms)"
    default 10000

config NOMIQ_LORA_FREQ_HZ
    int "LoRa frequency (Hz) — 865000000..867000000"
    default 865062500

config NOMIQ_LORA_SF
    int "Spreading factor (7..12)"
    range 7 12
    default 9

config NOMIQ_TX_DBM
    int "TX power (dBm, conducted)"
    range -9 22
    default 14

config NOMIQ_REG_PROFILE_SRD2021
    bool "Enforce 2.5% duty cycle (G.S.R. 853(E) 2021 SRD profile)"
    default n
    help
        See docs/adr/0003-india-regulatory-profile.md.

endmenu
```
